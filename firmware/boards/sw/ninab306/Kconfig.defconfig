## firmware/boards/sw/ninab306/ninab306_defconfig
```kconfig
# defines board-level default config settings  available to the board at all tiemes.

# ENABLE GPIO
CONFIG_GPIO=y

# Enable I2C
CONFIG_I2C=y

# Enable SPI
CONFIG_SPI=y

# Enable serial
CONFIG_SERIAL=y

# Enable usb cdc acm
CONFIG_USB_DEVICE_STACK=y
CONFIG_USB_DEVICE_DRIVER=y
CONFIG_USB_NRFX=y
CONFIG_USB_CDC_ACM=y
CONFIG_USB_CDC_ACM_RINGBUF_SIZE=1024

# Enable console
CONFIG_CONSOLE=y
CONFIG_UART_CONSOLE=y

# MEMORY PROTECTION
CONFIG_ARM_MPU=y
CONFIG_HW_STACK_PROTECTION=y

# ENABLE SENSORS
CONFIG_SENSOR=y
CONFIG_RTC=y
```

## firmware/build/Kconfig/Kconfig.shield
```kconfig
osource "/home/atia/Documents/watch_project/firmware/boards/shields/*/Kconfig.shield"
osource "/home/atia/ncs/v3.2.1/nrf/boards/shields/*/Kconfig.shield"
```

## firmware/build/firmware/Kconfig/Kconfig.shield
```kconfig
osource "/home/atia/Documents/watch_project/nrf_firmware/boards/shields/*/Kconfig.shield"
osource "/home/atia/ncs/v3.2.1/nrf/boards/shields/*/Kconfig.shield"
```

## firmware/build/firmware/Kconfig/Kconfig.shield.defconfig
```kconfig
osource "/home/atia/Documents/watch_project/firmware/boards/shields/*/Kconfig.defconfig"
osource "/home/atia/ncs/v3.2.1/nrf/boards/shields/*/Kconfig.defconfig"
```

## firmware/build/firmware/Kconfig/boards/Kconfig.defconfig
```kconfig
# Load Zephyr board defconfig descriptions.
osource "/home/atia/Documents/watch_project/firmware/boards/sw/ninab306/Kconfig.defconfig"
```

## firmware/build/firmware/Kconfig/boards/Kconfig.ninab306
```kconfig
# Load board Kconfig descriptions.
osource "/home/atia/Documents/watch_project/firmware/boards/sw/ninab306/Kconfig.ninab306"
```

## firmware/build/firmware/Kconfig/boards/Kconfig.sysbuild
```kconfig
# Load Sysbuild board Kconfig descriptions.
osource "/home/atia/Documents/watch_project/firmware/boards/sw/ninab306/Kconfig.sysbuild"
```
